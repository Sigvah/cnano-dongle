## config/west.yml
```yaml
manifest:
  remotes:
    - name: zmkfirmware
      url-base: https://github.com/zmkfirmware
    - name: badjeff
      url-base: https://github.com/badjeff
    - name: nrfconnect
      url-base: https://github.com/nrfconnect
    - name: sigvah
      url-base: https://github.com/sigvah
    - name: carrefinho
      url-base: https://github.com/carrefinho
    - name: caksoylar
      url-base: https://github.com/caksoylar
    - name: englmaxi
      url-base: https://github.com/englmaxi
    - name: damex
      url-base: https://github.com/damex
  projects:
    - name: zmk
      remote: zmkfirmware
      revision: main
      import: app/west.yml

    - name: zmk-pmw3610-driver
      remote: badjeff
      revision: main

    - name: zmk-dongle-display
      remote: englmaxi
      revision: main

    - name: forager-zmk-module
      remote: carrefinho
      revision: main
    - name: zmk-rgbled-widget
      remote: caksoylar
      revision: main
    - name: zmk-keyboards-visorbearer
      repo-path: visorbearer-zmk-module
      remote: carrefinho
      revision: main

    - name: prospector-zmk-module
      remote: sigvah
      revision: main

    - name: zmk-feature-split-esb
      remote: damex
      revision: v0.3.6
      import: true

  self:
    path: config
```
