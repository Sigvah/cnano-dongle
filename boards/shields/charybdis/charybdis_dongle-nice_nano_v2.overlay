// Board-specific overlay for nice!nano dongle with SH1106 OLED display
// Override the dongle_display OLED configuration

/ {
    chosen {
        zephyr,display = &oled;
    };
};

// Delete the default OLED node from dongle_display shield if it exists
/delete-node/ &{/soc/i2c@40003000/ssd1306@3c};

&pro_micro_i2c {
    status = "okay";

    oled: ssd1306@3c {
        compatible = "sinowealth,sh1106";
        reg = <0x3c>;
        width = <128>;
        height = <64>;
        segment-offset = <2>;
        page-offset = <0>;
        display-offset = <0>;
        multiplex-ratio = <63>;
        segment-remap;
        com-invdir;
        prechargep = <0x22>;
    };
};
