// Board-specific overlay for nice!nano dongle with SH1106 OLED display
// Defines the OLED device node that charybdis_dongle.overlay references

/ {
    chosen {
        zephyr,display = &oled;
    };
};

&pro_micro_i2c {
    status = "okay";

    oled: ssd1306@3c {
        compatible = "sinowealth,sh1106-i2c";
        reg = <0x3c>;
        width = <128>;
        height = <64>;
        segment-offset = <2>;
        page-offset = <0>;
        display-offset = <0>;
        multiplex-ratio = <63>;
        segment-remap;
        com-invdir;
        prechargep = <0x22>;
    };
};
