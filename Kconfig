## config/west.yml
```yaml
manifest:
  remotes:
    - name: zmkfirmware
      url-base: https://github.com/zmkfirmware
    - name: badjeff
      url-base: https://github.com/badjeff
    - name: nrfconnect
      url-base: https://github.com/nrfconnect
    - name: sigvah
      url-base: https://github.com/sigvah
    - name: carrefinho
      url-base: https://github.com/carrefinho
    - name: caksoylar
      url-base: https://github.com/caksoylar
    # - name: sadekbaroudi
    #   url-base: https://github.com/sadekbaroudi
    # - name: dhruvinsh
    #   url-base: https://github.com/dhruvinsh
    - name: englmaxi
      url-base: https://github.com/englmaxi
    - name: oleksandrmaslov
      url-base: https://github.com/oleksandrmaslov
  projects:
    - name: zmk
      remote: zmkfirmware
      revision: main
      import: app/west.yml

    - name: zmk-pmw3610-driver
      remote: badjeff
      revision: main

    - name: zmk-dongle-display
      remote: englmaxi
      revision: main

    - name: forager-zmk-module
      remote: carrefinho
      revision: main
    - name: zmk-rgbled-widget
      remote: caksoylar
      revision: main
    - name: zmk-keyboards-visorbearer
      repo-path: visorbearer-zmk-module
      remote: carrefinho
      revision: main

    # - name: zmk-tri-state
    #   remote: dhruvinsh
    #   revision: main
    # - name: zmk-fingerpunch-keyboards
    #   remote: sadekbaroudi
    #   revision: main
    #   import: config/deps.yml

    - name: prospector-zmk-module
      remote: carrefinho
      revision: feat/new-status-screens

    # Wafer board definition (wafer_left / wafer_right) and the soft-off module
    # its power button needs. Pinned together: the board expects this exact
    # soft-off-plus revision.
    - name: wafer-zmk-config
      remote: oleksandrmaslov
      revision: 4c110e7fec80e461b65f26f66961e5f6266118cb
    - name: zmk-soft-off-plus
      remote: oleksandrmaslov
      revision: ef9eacf6f08e77101df4c2f186b45c10cc467365

  self:
    path: config
```
